/*
 * Overlay pour Numpad 5x5 avec nice!nano v2
 * SPDX-License-Identifier: MIT
 */

#include "boards/shields/nice_nano_v2.overlay"

/ {
    chosen {
        zmk,kscan = &kscan;
    };

    kscan: kscan {
        compatible = "zmk,kscan-gpio-matrix";
        wakeup-source;

        diode-direction = "col2row";

        row-gpios =
            <&nice_nano 5 (GPIO_PULL_DOWN | GPIO_ACTIVE_HIGH)>,
            <&nice_nano 6 (GPIO_PULL_DOWN | GPIO_ACTIVE_HIGH)>,
            <&nice_nano 7 (GPIO_PULL_DOWN | GPIO_ACTIVE_HIGH)>,
            <&nice_nano 8 (GPIO_PULL_DOWN | GPIO_ACTIVE_HIGH)>,
            <&nice_nano 9 (GPIO_PULL_DOWN | GPIO_ACTIVE_HIGH)>;

        col-gpios =
            <&nice_nano 17 GPIO_ACTIVE_HIGH>,
            <&nice_nano 16 GPIO_ACTIVE_HIGH>,
            <&nice_nano 15 GPIO_ACTIVE_HIGH>,
            <&nice_nano 14 GPIO_ACTIVE_HIGH>,
            <&nice_nano 13 GPIO_ACTIVE_HIGH>;
    };
};
